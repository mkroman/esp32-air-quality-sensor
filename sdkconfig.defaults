## src/Kconfig
```kconfig
menu "ESP32 air quality sensor"

    menu "WiFi configuration"
        config WIFI_SSID
            string "WiFi SSID"
            default "myssid"
            help
                SSID (network name) for the example to connect to.

        config WIFI_PASSWORD
            string "WiFi Password"
            default "mypassword"
            help
                WiFi password (WPA or WPA2) for the example to use.
    endmenu

    menu "MQTT configuration"
        config MQTT_URL
            string "MQTT URL"
            default "mqtt://example.com:1883"
            help
                URL of the MQTT broker to connect to.

        config MQTT_USER
            string "MQTT Username"
            help
                The username to use with the mqtt broker.

        config MQTT_PASS
            string "MQTT Password"
            help
                The password to use with the mqtt broker.
    endmenu

    menu "I2C Master"
        config I2C_MASTER_SCL
            int "SCL GPIO Num"
            default 6 if IDF_TARGET_ESP32C3
            default 19 if IDF_TARGET_ESP32 || IDF_TARGET_ESP32S2 || IDF_TARGET_ESP32S3
            help
                GPIO number for I2C Master clock line.

        config I2C_MASTER_SDA
            int "SDA GPIO Num"
            default 5 if IDF_TARGET_ESP32C3
            default 18 if IDF_TARGET_ESP32 || IDF_TARGET_ESP32S2 || IDF_TARGET_ESP32S3
            help
                GPIO number for I2C Master data line.

        config I2C_MASTER_PORT_NUM
            int "Port Number"
            default 1 if IDF_TARGET_ESP32 || IDF_TARGET_ESP32S2 || IDF_TARGET_ESP32S3
            default 0 if IDF_TARGET_ESP32C3
            help
                Port number for I2C Master device.

        config I2C_MASTER_FREQUENCY
            int "Master Frequency"
            default 100000
            help
                I2C Speed of Master device.
    endmenu
endmenu
```
